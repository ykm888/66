## 888/mt7981_sl3000_defconfig
```kconfig
CONFIG_ARM=y
CONFIG_SYS_HAS_NONCACHED_MEMORY=y
CONFIG_POSITION_INDEPENDENT=y
CONFIG_ARCH_MEDIATEK=y
CONFIG_TEXT_BASE=0x41e00000
CONFIG_SYS_MALLOC_F_LEN=0x4000
CONFIG_NR_DRAM_BANKS=1
CONFIG_ENV_SIZE=0x10000
CONFIG_TARGET_MT7981=y
CONFIG_SYS_LOAD_ADDR=0x46000000
CONFIG_DEBUG_UART_BASE=0x11002000
CONFIG_DEBUG_UART_CLOCK=40000000
CONFIG_DEBUG_UART=y
CONFIG_MEDIATEK_BOOTMENU=y
CONFIG_MTK_BOOTMENU_SNOR_EMMC=y
CONFIG_MTK_WEB_FAILSAFE=y
CONFIG_MTK_WEB_FAILSAFE_AFTER_BOOT_FAILURE=y
CONFIG_MTK_WGET=y
CONFIG_MTK_ROOTDISK_OVERRIDE="emmc"
CONFIG_MTK_UPGRADE_BL2_VERIFY=y
CONFIG_MTK_UPGRADE_FIP_VERIFY=y
CONFIG_MTK_MISC_CUSTOMIZED=y
CONFIG_AUTOBOOT_MENU_SHOW=y
CONFIG_AUTOBOOT_MENU_MTK_SHOW=y
CONFIG_DEFAULT_FDT_FILE="mt7981-sl3000"
CONFIG_SYS_CBSIZE=512
CONFIG_SYS_PBSIZE=1049
CONFIG_LOGLEVEL=7
CONFIG_LOG=y
CONFIG_SYS_PROMPT="MT7981> "
CONFIG_CMD_GPIO=y
CONFIG_CMD_GPT=y
CONFIG_CMD_GPT_RENAME=y
CONFIG_CMD_LSBLK=y
CONFIG_CMD_MMC=y
CONFIG_CMD_MTD=y
CONFIG_CMD_PART=y
CONFIG_CMD_READ=y
CONFIG_CMD_WRITE=y
CONFIG_CMD_PING=y
CONFIG_CMD_SMC=y

# --- 【物理核心：1MB 救砖布局修正】 ---
# 1. 物理寻址死锁：告诉 U-Boot 自身位于 Flash 的 1MB 偏移处
CONFIG_SYS_U_BOOT_OFFS=0x100000

# 2. MTD 分区定义：bl2(1M) + fip(2M) + env(64K)
CONFIG_MTDIDS_DEFAULT="nor0=nor0"
CONFIG_MTDPARTS_DEFAULT="nor0:1M(bl2),2048k(fip),64k(u-boot-env),-(factory)"

# 3. 环境变量物理对齐：位于 1M + 2M = 3M ($0x300000) 处
CONFIG_ENV_IS_IN_MTD=y
CONFIG_ENV_MTD_DEV="u-boot-env"
CONFIG_ENV_OFFSET=0x300000
# ---------------------------------------

CONFIG_ENV_VARS_UBOOT_RUNTIME_CONFIG=y
CONFIG_USE_IPADDR=y
CONFIG_IPADDR="192.168.1.1"
CONFIG_USE_NETMASK=y
CONFIG_NETMASK="255.255.255.0"
CONFIG_USE_SERVERIP=y
CONFIG_SERVERIP="192.168.1.2"
CONFIG_NET_RANDOM_ETHADDR=y
CONFIG_CLK=y
CONFIG_SUPPORT_EMMC_BOOT=y
CONFIG_MMC_HS200_SUPPORT=y
CONFIG_MMC_MTK=y
CONFIG_DM_MTD=y
CONFIG_DM_SPI_FLASH=y
CONFIG_SPI_FLASH_SFDP_SUPPORT=y
CONFIG_SPI_FLASH_EON=y
CONFIG_SPI_FLASH_GIGADEVICE=y
CONFIG_SPI_FLASH_ISSI=y
CONFIG_SPI_FLASH_MACRONIX=y
CONFIG_SPI_FLASH_SPANSION=y
CONFIG_SPI_FLASH_STMICRO=y
CONFIG_SPI_FLASH_WINBOND=y
CONFIG_SPI_FLASH_XMC=y
CONFIG_SPI_FLASH_XTX=y
CONFIG_SPI_FLASH_MTD=y
CONFIG_PHY_FIXED=y
CONFIG_MEDIATEK_ETH=y
CONFIG_PINCTRL=y
CONFIG_PINCONF=y
CONFIG_PINCTRL_MT7981=y
CONFIG_DM_SERIAL=y
CONFIG_MTK_SERIAL=y
CONFIG_SPI=y
CONFIG_DM_SPI=y
CONFIG_MTK_SPIM=y
CONFIG_XZ=y
CONFIG_DEFAULT_DEVICE_TREE="mt7981-sl3000"
CONFIG_OF_LIST="mt7981-sl3000"
```

## u-boot/configs/mt7981_nor_emmc_rfb_defconfig
```kconfig
CONFIG_ARM=y
CONFIG_SYS_HAS_NONCACHED_MEMORY=y
CONFIG_POSITION_INDEPENDENT=y
CONFIG_ARCH_MEDIATEK=y
# --- 物理地址对齐 ---
CONFIG_TEXT_BASE=0x41e00000
# 核心：BL2 寻找 U-Boot 的物理基地址 (NOR 基址 0x40000000 + 1MB 偏移)
CONFIG_SYS_UBOOT_BASE=0x40100000
CONFIG_SYS_MALLOC_F_LEN=0x4000
CONFIG_NR_DRAM_BANKS=1
CONFIG_ENV_SIZE=0x10000
# 环境变量偏移锁定在 256k 位置 (与原版逻辑兼容，但不影响 1MB 处的 FIP)
CONFIG_ENV_OFFSET=0x40000
CONFIG_TARGET_MT7981=y
CONFIG_SYS_LOAD_ADDR=0x46000000
CONFIG_DEBUG_UART_BASE=0x11002000
CONFIG_DEBUG_UART_CLOCK=40000000
CONFIG_DEBUG_UART=y

# --- 救砖功能加固 ---
CONFIG_MEDIATEK_BOOTMENU=y
CONFIG_MTK_BOOTMENU_SNOR_EMMC=y
CONFIG_MTK_WEB_FAILSAFE=y
CONFIG_MTK_WEB_FAILSAFE_AFTER_BOOT_FAILURE=y
CONFIG_MTK_WGET=y
CONFIG_MTK_ROOTDISK_OVERRIDE="emmc"
CONFIG_MTK_UPGRADE_BL2_VERIFY=y
CONFIG_MTK_UPGRADE_FIP_VERIFY=y
CONFIG_MTK_MISC_CUSTOMIZED=y
CONFIG_AUTOBOOT_MENU_SHOW=y
CONFIG_AUTOBOOT_MENU_MTK_SHOW=y
CONFIG_DEFAULT_FDT_FILE="mt7981-sl3000"
CONFIG_SYS_CBSIZE=512
CONFIG_SYS_PBSIZE=1049
CONFIG_LOGLEVEL=7
CONFIG_LOG=y
CONFIG_SYS_PROMPT="SL-3000> "

# --- 物理分区表重构 (匹配 filogic.mk 1MB 偏移) ---
# 将前 1MB 完整划给 bl2，确保 1MB (0x100000) 处准时开始 fip (U-Boot)
CONFIG_MTDIDS_DEFAULT="nor0=nor0"
CONFIG_MTDPARTS_DEFAULT="nor0:1024k(bl2),2048k(fip),-(storage)"
CONFIG_PARTITION_TYPE_GUID=y
CONFIG_ENV_IS_IN_MTD=y
CONFIG_ENV_MTD_DEV="u-boot-env"

# --- 网络救砖配置 ---
CONFIG_USE_IPADDR=y
CONFIG_IPADDR="192.168.31.1"
CONFIG_USE_NETMASK=y
CONFIG_NETMASK="255.255.255.0"
CONFIG_USE_SERVERIP=y
CONFIG_SERVERIP="192.168.31.2"
CONFIG_NET_RANDOM_ETHADDR=y

# --- 硬件驱动支持 ---
CONFIG_CLK=y
CONFIG_CMD_GPIO=y
CONFIG_CMD_GPT=y
CONFIG_CMD_GPT_RENAME=y
CONFIG_CMD_LSBLK=y
CONFIG_CMD_MMC=y
CONFIG_CMD_MTD=y
CONFIG_CMD_PART=y
CONFIG_CMD_READ=y
CONFIG_CMD_WRITE=y
CONFIG_CMD_PING=y
CONFIG_CMD_SMC=y
CONFIG_MMC_MTK=y
CONFIG_DM_MTD=y
CONFIG_DM_SPI_FLASH=y
CONFIG_SPI_FLASH_SFDP_SUPPORT=y
CONFIG_SPI_FLASH_WINBOND=y
CONFIG_SPI_FLASH_MTD=y
CONFIG_MEDIATEK_ETH=y
CONFIG_PINCTRL=y
CONFIG_PINCTRL_MT7981=y
CONFIG_DM_SERIAL=y
CONFIG_MTK_SERIAL=y
CONFIG_SPI=y
CONFIG_DM_SPI=y
CONFIG_MTK_SPIM=y
CONFIG_XZ=y

# --- 设备树锁定 ---
CONFIG_DEFAULT_DEVICE_TREE="mt7981-sl3000"
CONFIG_OF_LIST="mt7981-sl3000"
```
